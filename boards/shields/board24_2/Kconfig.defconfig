## boards/shields/board24_2/Kconfig.defconfig
```kconfig
# Copyright (c) 2024 The ZMK Contributors
  # SPDX-License-Identifier: MIT

    if SHIELD_BOARD24_2_L

    config ZMK_KEYBOARD_NAME
    	default "Board24_2"

    config ZMK_SPLIT_ROLE_CENTRAL
    	default y

    endif

    if SHIELD_BOARD24_2_L || SHIELD_BOARD24_2_R

    config ZMK_SPLIT
    	default y

    endif
    
```

## boards/shields/board24_2/Kconfig.shield
```kconfig
# Copyright (c) 2024 The ZMK Contributors
# SPDX-License-Identifier: MIT

config SHIELD_BOARD24_2_L
	def_bool $(shields_list_contains,board24_2_l)

  config SHIELD_BOARD24_2_R
  	def_bool $(shields_list_contains,board24_2_r)
    
```

## config/west.yml
```yaml
manifest:
  remotes:
    - name: zmkfirmware
      url-base: https://github.com/zmkfirmware
  projects:
    - name: zmk
      remote: zmkfirmware
      revision: 8c8d3d3a0c5d96e9b4dba61ba2e2ddc9a1f5aea7
      import: app/west.yml
  self:
    path: config
```
